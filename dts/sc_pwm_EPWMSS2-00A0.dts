/*
 * Copyright (C) 2013 Jean Gregory Verret 
 *
 * This program is free software; you can redistribute it and/or modify
 * it under the terms of the GNU General Public License version 2 as
 * published by the Free Software Foundation.
 *
 */

/* ****************************************************************************
 * Pulse-width Modulation Subsystem 
 *
 * epwmss0
 *     ehrpwm0
 *         A P9.22 | P9.31
 *         B P9.21 | P9.29
 *     cap0
 *         P9.42
 *
 * epwmss1
 *     ehrpwm1
 *         A P8.36 | P9.14
 *         B P8.34 | P9.16
 *
 * [epwmss2]
 *     ehrpwm2
 *         A P8.19 | P8.45
 *         B P8.13 | P8.46
 *     ecap2
 *         P9.28
 * ************************************************************************** */

/dts-v1/;
/plugin/;

/ {
	compatible = "ti,beaglebone","ti,beaglebone-black";

	/* Identification */
	part-number = "sc_pwm_EPWMSS2";
	version = "00A0";

	fragment@0 {
		target = <&epwmss2>;
		__overlay__ {
			status = "okay";
		};
	};
};

